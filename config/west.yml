## config/west.yml
```yaml
manifest:
  remotes:
    - name: zmkfirmware
      url-base: https://github.com/petejohanson
    - name: badjeff
      url-base: https://github.com/badjeff
  projects:
    - name: zmk
      remote: zmkfirmware
      revision: 116e2ea48f6c
      import: app/west.yml
    - name: zmk-pmw3610-driver
      remote: badjeff
      revision: 1ddfa25bbb81
    - name: zmk-split-peripheral-input-relay
      remote: badjeff
      revision: f49a5ca22a7b
    - name: zmk-input-behavior-listener
      remote: badjeff
      revision: 80fc27026a28
  self:
    path: config
```
